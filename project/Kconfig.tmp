## project/Kconfig.tmp
```kconfig
source "D:/SiFli/sifli-sdk/customer/boards/CWatch/hcpu/Kconfig.board"
source "$SIFLI_SDK/customer/boards/Kconfig.v2"
source "$SIFLI_SDK/Kconfig.v2"
rsource "Kconfig.proj"
```
